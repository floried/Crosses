## config/west.yml
```yaml
manifest:
  defaults:
    revision: main
  remotes:
    - name: zmkfirmware
      url-base: https://github.com/zmkfirmware
    - name: floried
      url-base: https://github.com/floried
    - name: kot149
      url-base: https://github.com/kot149
  projects:
    - name: zmk
      remote: zmkfirmware
      revision: ac7f75b8591d39aaf3b66b9d26f26c9ed921a009
      import: app/west.yml
    - name: gggw-zmk-keebs
      remote: floried
      revision: zephyr-4.1
      import: config/west.yml
    - name: zmk-scroll-snap
      remote: kot149
      revision: v1
  self:
    path: config
```
